# WIDGET_M4 register map
Vendor: Widget Devices; File version: 1.0
Fixture Cortex-M4 part & its peripherals
CPU: CM4 r0p1, little endian, no MPU, no FPU, 4 interrupt priority bits
Registers are 32-bit, access not given, reset 0x0 unless marked. A register's access mark holds for its fields unless they carry their own. Offsets are from the block's base; lines under a group give offsets from that group; [hi:lo] are bit positions; {n}, {i} and the like mark numbered series; 'fields as' and 'values as' point back to an identical list; <NAME> marks a mode.

## Memory map
{0x3FFFF800+0x400*n} TIM{n} (n=2..3) size 0x400 — General-purpose timers
0x40004400 USART2 size 0x400
0x40011000 USART1 size 0x400 — Universal <synchronous/asynchronous> receiver transmitter
0x40023000 CRC size 0x4 — Cyclic redundancy check unit: its first word only, the rest reserved
0xE000ED00 SCB size 0x41 — System control block

## Interrupts
37 USART1 — USART1 global interrupt
38 USART2

## USART1 — Universal <synchronous/asynchronous> receiver transmitter
Base 0x40011000
Same registers: USART2 0x40004400
0x00 SR reset 0xC0 — Status register
  [5] RXNE — Read data register not empty
0x04 DR — Data register
0x0C CR1 — Control register 1

## TIM{n} — General-purpose timers
Base 0x40000000; array of 2, step 0x400

## Notices in the file
SPDX-License-Identifier: Apache-2.0
