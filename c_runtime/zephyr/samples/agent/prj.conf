## CMakeLists.txt
```
# SPDX-License-Identifier: Apache-2.0
# The bhf reference agent on Zephyr (#291): build with
#   west build -b qemu_cortex_m3 c_runtime/zephyr/samples/agent
# and drive it with `bhf fuzz --target-transport agent:tcp:...` over the
# board's second UART (see c_runtime/zephyr/README.md).
cmake_minimum_required(VERSION 3.20.0)
list(APPEND ZEPHYR_EXTRA_MODULES ${CMAKE_CURRENT_SOURCE_DIR}/../..)
find_package(Zephyr REQUIRED HINTS $ENV{ZEPHYR_BASE})
project(bhf_agent_sample)

target_sources(app PRIVATE src/main.c src/target.c)
# Only the code under test is instrumented: the agent and Zephyr are not.
set_source_files_properties(src/target.c PROPERTIES COMPILE_OPTIONS -fsanitize-coverage=trace-pc)
```

## prj.conf
```kconfig
# SPDX-License-Identifier: Apache-2.0
CONFIG_SERIAL=y
CONFIG_BHF_AGENT=y
```

## boards/qemu_cortex_m3.overlay
```dts
/* SPDX-License-Identifier: Apache-2.0 */
/* UART0 keeps the console; the agent serves on UART1, QEMU's second
 * -serial. */
/ {
	chosen {
		bhf,agent-uart = &uart1;
	};
};
```

## src/main.c
```c
/* SPDX-License-Identifier: Apache-2.0 */
#include <stddef.h>
#include <stdint.h>

#include "bhf_agent_zephyr.h"

int LLVMFuzzerTestOneInput(const uint8_t *data, size_t size);

int main(void) {
    bhf_agent_zephyr_run(LLVMFuzzerTestOneInput);
    return 0;
}
```

## src/target.c
```c
/* SPDX-License-Identifier: Apache-2.0 */
/* The code under test of the Zephyr agent sample (#291), built with
 * -fsanitize-coverage=trace-pc: each matched byte of "BUG" is new code, and
 * the whole of it executes an undefined instruction (a CPU exception). */
#include <stddef.h>
#include <stdint.h>

int LLVMFuzzerTestOneInput(const uint8_t *data, size_t size) {
    if (size > 0 && data[0] == 'B') {
        if (size > 1 && data[1] == 'U') {
            if (size > 2 && data[2] == 'G') {
                __asm volatile("udf #0");
            }
        }
    }
    return 0;
}
```
